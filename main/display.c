#include "display.h"
#include "config.h"
#include "i2c_bus.h"
#include "esp_log.h"
#include <string.h>

static const char *TAG = "OLED";
static i2c_master_dev_handle_t s_dev;
static bool s_ready;
static uint8_t fb[OLED_WIDTH * OLED_HEIGHT / 8];

static const uint8_t font5x7[96][5] = {
    [32]={0,0,0,0,0},
    [33]={0,0x5f,0,0,0}, [34]={0x03,0,0x03,0,0}, [35]={0x14,0x7f,0x14,0x7f,0x14},
    [36]={0x24,0x2a,0x7f,0x2a,0x12}, [37]={0x23,0x13,0x08,0x64,0x62},
    [38]={0x36,0x49,0x55,0x22,0x50}, [39]={0,0x05,0x03,0,0},
    [40]={0,0x1c,0x22,0x41,0}, [41]={0,0x41,0x22,0x1c,0},
    [42]={0x14,0x08,0x3e,0x08,0x14}, [43]={0x08,0x08,0x3e,0x08,0x08},
    [44]={0,0x50,0x30,0,0}, [45]={0x08,0x08,0x08,0x08,0x08},
    [46]={0,0x60,0x60,0,0}, [47]={0x20,0x10,0x08,0x04,0x02},
    [48]={0x3e,0x51,0x49,0x45,0x3e}, [49]={0,0x42,0x7f,0x40,0},
    [50]={0x42,0x61,0x51,0x49,0x46}, [51]={0x21,0x41,0x45,0x4b,0x31},
    [52]={0x18,0x14,0x12,0x7f,0x10}, [53]={0x27,0x45,0x45,0x45,0x39},
    [54]={0x3c,0x4a,0x49,0x49,0x30}, [55]={0x01,0x71,0x09,0x05,0x03},
    [56]={0x36,0x49,0x49,0x49,0x36}, [57]={0x06,0x49,0x49,0x29,0x1e},
    [58]={0,0x36,0x36,0,0}, [59]={0,0x56,0x36,0,0}, [60]={0x08,0x14,0x22,0x41,0},
    [61]={0x14,0x14,0x14,0x14,0x14}, [62]={0x41,0x22,0x14,0x08,0},
    [63]={0x02,0x01,0x51,0x09,0x06}, [64]={0x3e,0x41,0x5d,0x59,0x4e},
    [65]={0x7e,0x11,0x11,0x11,0x7e}, [66]={0x7f,0x49,0x49,0x49,0x36},
    [67]={0x3e,0x41,0x41,0x41,0x22}, [68]={0x7f,0x41,0x41,0x22,0x1c},
    [69]={0x7f,0x49,0x49,0x49,0x41}, [70]={0x7f,0x09,0x09,0x09,0x01},
    [71]={0x3e,0x41,0x49,0x49,0x7a}, [72]={0x7f,0x08,0x08,0x08,0x7f},
    [73]={0,0x41,0x7f,0x41,0}, [74]={0x20,0x40,0x41,0x3f,0x01},
    [75]={0x7f,0x08,0x14,0x22,0x41}, [76]={0x7f,0x40,0x40,0x40,0x40},
    [77]={0x7f,0x02,0x0c,0x02,0x7f}, [78]={0x7f,0x04,0x08,0x10,0x7f},
    [79]={0x3e,0x41,0x41,0x41,0x3e}, [80]={0x7f,0x09,0x09,0x09,0x06},
    [81]={0x3e,0x41,0x51,0x21,0x5e}, [82]={0x7f,0x09,0x19,0x29,0x46},
    [83]={0x46,0x49,0x49,0x49,0x31}, [84]={0x01,0x01,0x7f,0x01,0x01},
    [85]={0x3f,0x40,0x40,0x40,0x3f}, [86]={0x1f,0x20,0x40,0x20,0x1f},
    [87]={0x3f,0x40,0x38,0x40,0x3f}, [88]={0x63,0x14,0x08,0x14,0x63},
    [89]={0x07,0x08,0x70,0x08,0x07}, [90]={0x61,0x51,0x49,0x45,0x43},
    [91]={0,0x7f,0x41,0x41,0}, [92]={0x02,0x04,0x08,0x10,0x20},
    [93]={0,0x41,0x41,0x7f,0}, [94]={0x04,0x02,0x01,0x02,0x04},
    [95]={0x40,0x40,0x40,0x40,0x40},
};

static esp_err_t cmd(uint8_t c)
{
    uint8_t p[2] = {0x00, c};
    return i2c_master_transmit(s_dev, p, 2, 100);
}

static esp_err_t data(const uint8_t *d, size_t n)
{
    uint8_t *p = malloc(n + 1);
    if (!p) return ESP_ERR_NO_MEM;
    p[0] = 0x40;
    memcpy(p + 1, d, n);
    esp_err_t e = i2c_master_transmit(s_dev, p, n + 1, 100);
    free(p);
    return e;
}

static void glyph(int x, int y, char ch, int scale)
{
    if (ch < 32 || ch > 95) ch = '?';
    const uint8_t *g = font5x7[(unsigned char)ch];
    for (int col = 0; col < 5; col++) {
        for (int row = 0; row < 7; row++) {
            if (g[col] & (1u << row)) {
                for (int dx=0; dx<scale; dx++)
                    for (int dy=0; dy<scale; dy++)
                        display_draw_pixel(x + col*scale + dx,
                                           y + row*scale + dy, true);
            }
        }
    }
}

esp_err_t display_init(void)
{
    if (i2c_probe(OLED_I2C_ADDR) != ESP_OK) {
        ESP_LOGE(TAG, "No OLED found at 0x%02X", OLED_I2C_ADDR);
        return ESP_ERR_NOT_FOUND;
    }

    i2c_device_config_t dev_cfg = {
        .dev_addr_length = I2C_ADDR_BIT_LEN_7,
        .device_address = OLED_I2C_ADDR,
        .scl_speed_hz = 400000,
    };

    esp_err_t e = i2c_master_bus_add_device(i2c_bus_get_handle(), &dev_cfg, &s_dev);
    if (e != ESP_OK) return e;

    const uint8_t init[] = {
        0xAE,0xD5,0x80,0xA8,0x3F,0xD3,0x00,0x40,0x8D,0x14,0x20,0x00,
        0xA1,0xC8,0xDA,0x12,0x81,0x7F,0xD9,0xF1,0xDB,0x40,0xA4,0xA6,0xAF
    };
    for (size_t i=0;i<sizeof(init);i++) {
        e = cmd(init[i]);
        if (e != ESP_OK) {
            ESP_LOGE(TAG, "OLED command 0x%02X failed: %s", init[i], esp_err_to_name(e));
            return e;
        }
    }

    memset(fb, 0, sizeof(fb));
    s_ready = true;
    display_update();
    ESP_LOGI(TAG, "SSD1306 ready at 0x%02X", OLED_I2C_ADDR);
    return ESP_OK;
}

bool display_is_ready(void) { return s_ready; }

void display_clear(void) { memset(fb, 0, sizeof(fb)); }

void display_draw_pixel(int x, int y, bool on)
{
    if (x < 0 || x >= OLED_WIDTH || y < 0 || y >= OLED_HEIGHT) return;
    size_t i = x + (y / 8) * OLED_WIDTH;
    uint8_t mask = 1u << (y & 7);
    if (on) fb[i] |= mask;
    else fb[i] &= (uint8_t)~mask;
}

void display_draw_rect(int x, int y, int w, int h, bool on)
{
    display_draw_hline(x,y,w,on);
    display_draw_hline(x,y+h-1,w,on);
    display_draw_vline(x,y,h,on);
    display_draw_vline(x+w-1,y,h,on);
}

void display_fill_rect(int x, int y, int w, int h, bool on)
{
    for (int yy=y; yy<y+h; yy++)
        for (int xx=x; xx<x+w; xx++)
            display_draw_pixel(xx,yy,on);
}

void display_draw_hline(int x,int y,int w,bool on)
{
    for(int i=0;i<w;i++) display_draw_pixel(x+i,y,on);
}

void display_draw_vline(int x,int y,int h,bool on)
{
    for(int i=0;i<h;i++) display_draw_pixel(x,y+i,on);
}

void display_text(int x,int y,const char *text,int scale,bool on)
{
    while (*text) {
        glyph(x,y,*text,scale);
        x += 6*scale;
        text++;
    }
}

void display_center_text(const char *text,int y,int scale,bool on)
{
    int len = (int)strlen(text);
    int width = len * 6 * scale;
    display_text((OLED_WIDTH-width)/2,y,text,scale,on);
}

void display_update(void)
{
    if (!s_ready) return;
    for (uint8_t page=0; page<8; page++) {
        cmd(0xB0 | page);
        cmd(0x00);
        cmd(0x10);
        data(&fb[page*128],128);
    }
}
